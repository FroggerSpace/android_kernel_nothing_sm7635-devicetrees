&mdss_mdp {
	dsi_nt37706a_amoled_120hz_vid_vxn: qcom,mdss_dsi_nt37706a_120hz_fhd_plus_dsc_vid_vxn {
		qcom,mdss-dsi-panel-name =
			"nt37706a amoled vid mode dsi VXN panel with DSC";
		qcom,mdss-dsi-panel-type = "dsi_video_mode";
		qcom,mdss-dsi-panel-physical-type = "oled";
		qcom,mdss-dsi-virtual-channel-id = <0>;
		qcom,mdss-dsi-stream = <0>;
		qcom,mdss-dsi-bpp = <30>;
		qcom,mdss-dsi-color-order = "rgb_swap_rgb";
		qcom,mdss-dsi-underflow-color = <0xff>;
		qcom,mdss-dsi-border-color = <0>;

		qcom,dsi-ctrl-num = <0>;
		qcom,dsi-phy-num = <0>;

		qcom,mdss-dsi-traffic-mode = "non_burst_sync_event";
		qcom,mdss-dsi-bllp-power-mode;
		qcom,mdss-dsi-bllp-eof-power-mode;
		qcom,mdss-dsi-lane-map = "lane_map_0123";
		qcom,mdss-dsi-lane-0-state;
		qcom,mdss-dsi-lane-1-state;
		qcom,mdss-dsi-lane-2-state;
		qcom,mdss-dsi-lane-3-state;
		qcom,mdss-dsi-lp11-init;
		qcom,mdss-dsi-dma-trigger = "trigger_sw";
		qcom,mdss-dsi-mdp-trigger = "none";
		qcom,mdss-dsi-reset-sequence = <1 1>, <0 1>, <1 10>;
		qcom,mdss-pan-physical-width-dimension = <71>;
		qcom,mdss-pan-physical-height-dimension = <157>;

		qcom,mdss-dsi-panel-hdr-color-primaries = <14500 15500 32000
				17000 15500 30000 8000 3000>;
		qcom,mdss-dsi-panel-peak-brightness = <16000000>;
		qcom,mdss-dsi-panel-blackness-level = <3230>;

		qcom,mdss-dsi-display-timings {
			timing@0 {
				cell-index = <0>;
				qcom,mdss-dsi-panel-framerate = <120>;
				qcom,mdss-dsi-panel-width = <1224>;
				qcom,mdss-dsi-panel-height = <2720>;
				qcom,mdss-dsi-h-front-porch = <41>;
				qcom,mdss-dsi-h-back-porch = <16>;
				qcom,mdss-dsi-h-pulse-width = <16>;
				qcom,mdss-dsi-h-sync-skew = <0>;
				qcom,mdss-dsi-v-back-porch = <46>;
				qcom,mdss-dsi-v-front-porch = <76>;
				qcom,mdss-dsi-v-pulse-width = <2>;
				qcom,mdss-dsi-h-left-border = <0>;
				qcom,mdss-dsi-h-right-border = <0>;
				qcom,mdss-dsi-v-top-border = <0>;
				qcom,mdss-dsi-v-bottom-border = <0>;
				qcom,mdss-dsi-panel-jitter = <0x4 0x1>;

				qcom,vid-on-commands = [
					39 01 00 00 00 00 05 FF AA 55 A5 80
					15 01 00 00 00 00 02 6F 1F
					15 01 00 00 00 00 02 F4 0B
					15 01 00 00 00 00 02 6F 20
					15 01 00 00 00 00 02 F4 3F
					15 01 00 00 00 00 02 6F 08
					15 01 00 00 00 00 02 FC 03
					39 01 00 00 00 00 05 FF AA 55 A5 80
					15 01 00 00 00 00 02 6F 24
					15 01 00 00 00 00 02 F8 FF
					39 01 00 00 00 00 05 FF AA 55 A5 84
					15 01 00 00 00 00 02 6F 10
					15 01 00 00 00 00 02 F8 02
					39 01 00 00 00 00 05 FF AA 55 A5 84
					15 01 00 00 00 00 02 F2 15
					39 01 00 00 00 00 05 FF AA 55 A5 84
					15 01 00 00 00 00 02 6F 27
					15 01 00 00 00 00 02 F7 00
					39 01 00 00 00 00 05 FF AA 55 A5 84
					15 01 00 00 00 00 02 6F A9
					15 01 00 00 00 00 02 F4 F3
					15 01 00 00 00 00 02 87 00
					15 01 00 00 00 00 02 17 03
					39 01 00 00 00 00 05 2A 00 00 04 C7
					39 01 00 00 00 00 05 2B 00 00 0A 9F
					39 01 00 00 00 00 03 90 03 43
					39 01 00 00 00 00 13 91 AB A8 00 28 E2 00 02 65 03 C7 00 08 02 E0 02 3F 10 F0
					15 01 00 00 00 00 02 53 20
					39 01 00 00 00 00 11 3B 00 30 00 50 00 30 00 4C 00 30 04 00 00 30 0B 68
					15 01 00 00 00 00 02 6F 10
					39 01 00 00 00 00 05 3B 00 30 00 4C
					15 01 00 00 00 00 02 88 01
					39 01 00 00 00 00 03 81 01 19
					15 01 00 00 00 00 02 35 00
					15 01 00 00 00 00 02 2F 00
					39 01 00 00 00 00 06 F0 55 AA 52 08 00
					15 01 00 00 00 00 02 BE 47
					39 01 00 00 00 00 06 F0 55 AA 52 08 00
					15 01 00 00 00 00 02 B2 91
					05 01 00 00 78 00 01 11
					05 01 00 00 00 00 01 29

				];
				qcom,mdss-dsi-on-command-state = "dsi_lp_mode";
				qcom,mdss-dsi-off-command = [
					05 01 00 00 14 00 02 28 00
					05 01 00 00 64 00 02 10 00];
				qcom,mdss-dsi-off-command-state = "dsi_lp_mode";

				qcom,mdss-dsi-switch-120hz-command = [
					15 01 00 00 00 00 02 2F 00
				];
				qcom,mdss-dsi-switch-120hz-command-state = "dsi_hs_mode";
				qcom,mdss-dsi-switch-90hz-command = [
					15 01 00 00 00 00 02 2F 01
				];
				qcom,mdss-dsi-switch-90hz-command-state = "dsi_hs_mode";
				qcom,mdss-dsi-switch-60hz-command = [
					15 01 00 00 00 00 02 2F 02
				];
				qcom,mdss-dsi-switch-60hz-command-state = "dsi_hs_mode";

				qcom,mdss-dsi-switch-120hz-command-compatibility = [
					39 01 00 00 00 00 13 A9 01 00 2F 00 00 00 01 00 A2 00 06 07 02 01 BA 22 22 01
				];
				qcom,mdss-dsi-switch-120hz-command-compatibility-state = "dsi_hs_mode";
				qcom,mdss-dsi-switch-90hz-command-compatibility = [
					39 01 00 00 00 00 13 A9 01 00 2F 00 00 01 01 00 A2 00 06 07 02 01 BA 22 22 02
				];
				qcom,mdss-dsi-switch-90hz-command-state-compatibility = "dsi_hs_mode";
				qcom,mdss-dsi-switch-60hz-command-compatibility = [
					39 01 00 00 00 00 13 A9 01 00 2F 00 00 02 01 00 A2 00 06 07 02 01 BA 22 22 03
				];
				qcom,mdss-dsi-switch-60hz-command-state-compatibility = "dsi_hs_mode";

				qcom,mdss-dsi-switch-30hz-gear0-command = [
						39 01 00 40 00 00 1F A9 01 00 51 04 05 00 00 02 00 B4 68 6F 00 04 00 04 00 04 00 04 02 01 E7 01 05 20 18 08 88 0C
						05 01 00 00 00 00 01 39
				];
				qcom,mdss-dsi-switch-30hz-gear0-command-state = "dsi_hs_mode";

				qcom,mdss-dsi-switch-30hz-gear1-command = [
						39 01 00 40 00 00 1F A9 01 00 51 04 05 01 55 02 00 B4 68 6F 00 04 00 04 00 04 00 04 02 01 E7 01 05 20 18 08 88 0C
						05 01 00 00 00 00 01 39
				];
				qcom,mdss-dsi-switch-30hz-gear1-command-state = "dsi_hs_mode";

				qcom,mdss-dsi-switch-30hz-gear2-command = [
						39 01 00 40 00 00 1F A9 01 00 51 04 05 08 00 02 00 B4 68 6F 00 04 00 18 00 20 00 20 02 01 E7 01 05 20 18 18 28 0C
						05 01 00 00 00 00 01 39
				];
				qcom,mdss-dsi-switch-30hz-gear2-command-state = "dsi_hs_mode";

				qcom,mdss-dsi-switch-30hz-gear3-command = [
						39 01 00 40 00 00 1F A9 01 00 51 04 05 0F FF 02 00 B4 68 6F 00 04 00 18 00 20 00 20 02 01 E7 01 05 20 18 18 28 0C
						05 01 00 00 00 00 01 39
				];
				qcom,mdss-dsi-switch-30hz-gear3-command-state = "dsi_hs_mode";
				qcom,mdss-dsi-exit-30hz-command = [
						39 01 00 40 00 00 03 51 00 00
						05 01 00 00 00 00 01 38
				];
				qcom,mdss-dsi-exit-30hz-command-state = "dsi_hs_mode";

				qcom,mdss-dsi-lhbm-on-command = [
					39 01 00 00 00 00 19 A9 01 00 87 00 00 25 02 00 DF 0F 0F 00 02 00 DF 74 74 00 01 00 8B 01 01 01
				];
				qcom,mdss-dsi-lhbm-on-command-state = "dsi_hs_mode";
				qcom,mdss-dsi-lhbm-off-command = [
					39 01 00 00 00 00 0D A9 01 00 87 00 00 00 01 00 8B 01 01 00
				];
				qcom,mdss-dsi-lhbm-off-command-state = "dsi_hs_mode";

				qcom,compression-mode = "dsc";
				qcom,mdss-dsc-version = <0x12>;
				qcom,mdss-dsc-slice-height = <40>;
				qcom,mdss-dsc-slice-width = <612>;
				qcom,mdss-dsc-slice-per-pkt = <2>;
				qcom,mdss-dsc-bit-per-component = <10>;
				qcom,mdss-dsc-bit-per-pixel = <8>;
				qcom,mdss-dsc-block-prediction-enable;
			};
		};
	};
};
